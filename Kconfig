## Kconfig
```kconfig
DT_COMPAT_TOTEM_BATTERY_LIPO_DIVIDER := totem,battery-lipo-divider

config TOTEM_BATTERY_LIPO_DIVIDER
    bool
    default $(dt_compat_enabled,$(DT_COMPAT_TOTEM_BATTERY_LIPO_DIVIDER))
    select ADC
    depends on SENSOR
    help
        Battery voltage divider driver that maps LiPo voltage to state of
        charge using a discharge curve instead of a straight line.

DT_COMPAT_TOTEM_BEHAVIOR_ADV_BURST := totem,behavior-adv-burst

config TOTEM_BEHAVIOR_ADV_BURST
    bool
    default $(dt_compat_enabled,$(DT_COMPAT_TOTEM_BEHAVIOR_ADV_BURST))
    depends on ZMK_BLE && (!ZMK_SPLIT || ZMK_SPLIT_ROLE_CENTRAL)
    help
        Behavior that advertises for a short time without dropping the host
        connection, so Web Bluetooth pages can discover the keyboard.

config TOTEM_IDLE_POWER_SAVING
    bool "Slow the split link while the keyboard is idle"
    default y
    depends on ZMK_SPLIT_BLE && ZMK_SPLIT_ROLE_CENTRAL
    help
        Lengthens the connection interval to the right half while ZMK reports
        the keyboard as idle, and restores it on the next key press. A bonded
        host can turn this on or off over GATT.

config TOTEM_IDLE_POWER_SAVING_INTERVAL
    int "Split link connection interval while idle, in 1.25 ms units"
    default 24
    depends on TOTEM_IDLE_POWER_SAVING
```

## dts/bindings/behaviors/totem,behavior-adv-burst.yaml
```yaml
description: Advertise briefly while staying connected, for Web Bluetooth discovery

compatible: "totem,behavior-adv-burst"

include: zero_param.yaml

properties:
  duration-ms:
    type: int
    default: 10000
```

## dts/bindings/sensor/totem,battery-lipo-divider.yaml
```yaml
description: LiPo battery state of charge via voltage divider and discharge curve

compatible: "totem,battery-lipo-divider"

include: voltage-divider.yaml

properties:
  voltage-scale-permille:
    type: int
    default: 1000
    description: |
      Per-board correction for the divider resistors' tolerance and the ADC's
      gain error, in thousandths: readings are multiplied by this / 1000 before
      the curve lookup. 1000 means no correction; 1037 means the board reads
      3.7% low. It belongs to the controller board, not the battery.
```
