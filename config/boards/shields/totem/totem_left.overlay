/*
 * Copyright (c) 2022 The ZMK Contributors
 *
 * SPDX-License-Identifier: MIT
 */

#include "totem.dtsi"

&kscan0 {
    col-gpios
        = <&xiao_d 4 GPIO_ACTIVE_HIGH>
        , <&xiao_d 5 GPIO_ACTIVE_HIGH>
        , <&xiao_d 10 GPIO_ACTIVE_HIGH>
        , <&xiao_d 9 GPIO_ACTIVE_HIGH>
        , <&xiao_d 8 GPIO_ACTIVE_HIGH>
        ;
};

// This XIAO's battery readings run about 3.7% low. Raise the value if a full battery
// stops short of 100%; lower it if the level stays at 100% too long after charging.
// Calibrate again when swapping the XIAO board; a new battery needs no change.
&vbatt {
    voltage-scale-permille = <1037>;
};
